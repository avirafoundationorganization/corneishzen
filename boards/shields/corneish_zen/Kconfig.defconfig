## boards/shields/corneish_zen/Kconfig.defconfig
```kconfig
if SHIELD_CORNEISH_ZEN_DONGLE

config ZMK_KEYBOARD_NAME
    default "CorneZenDongle"

config ZMK_SPLIT_ROLE_CENTRAL
    default y

endif

if SHIELD_CORNEISH_ZEN_LEFT || SHIELD_CORNEISH_ZEN_RIGHT || SHIELD_CORNEISH_ZEN_DONGLE

config ZMK_SPLIT
    default y

config ZMK_BLE
    default y

config ZMK_BATTERY_REPORTING
    default y
endif
```

## boards/shields/corneish_zen/Kconfig.shield
```kconfig
config SHIELD_CORNEISH_ZEN_LEFT
    def_bool $(shields_list_contains,corneish_zen_left)

config SHIELD_CORNEISH_ZEN_RIGHT
    def_bool $(shields_list_contains,corneish_zen_right)

config SHIELD_CORNEISH_ZEN_DONGLE
    def_bool $(shields_list_contains,corneish_zen_dongle)
```

## config/west.yml
```yaml
manifest:
  remotes:
    - name: zmkfirmware
      url-base: https://github.com/zmkfirmware
    - name: caksoylar
      url-base: https://github.com/caksoylar
    - name: avirafoundationorganization
      url-base: https://github.com/avirafoundationorganization
  projects:
    - name: zmk
      remote: zmkfirmware
      revision: main
      import: app/west.yml
    - name: zmk-rgbled-widget
      remote: caksoylar
      revision: main
    - name: corneishzen
      remote: avirafoundationorganization
      revision: main
  self:
    path: config
```
